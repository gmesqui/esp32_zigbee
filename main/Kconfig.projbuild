## main/Kconfig.projbuild
```kconfig
menu "MQTT Bridge"

    config MQTT_BRIDGE_MDNS_HOSTNAME
        string "mDNS hostname"
        default "zb-coordinator"
        help
            Hostname anunciado por mDNS cuando el coordinador obtiene IP por Ethernet.

    config MQTT_BRIDGE_MDNS_INSTANCE
        string "mDNS instance name"
        default "ESP32-C5 Zigbee Coordinator"
        help
            Nombre descriptivo anunciado por mDNS.

    config MQTT_BRIDGE_MQTT_BROKER_URI
        string "MQTT broker URI"
        default ""
        help
            URI del broker MQTT. Ejemplo: mqtt://192.168.1.10:1883
            Si se deja vacio, el bridge no arranca el cliente MQTT.

    config MQTT_BRIDGE_MQTT_CLIENT_ID
        string "MQTT client id"
        default "esp32c5-zb-coordinator"
        help
            Client ID usado por el cliente MQTT del coordinador.

    config MQTT_BRIDGE_BASE_TOPIC
        string "MQTT base topic"
        default "esp32_zigbee"
        help
            Prefijo MQTT usado para publicar estado del bridge, dispositivos y recibir ordenes.

endmenu
```

## sdkconfig.defaults
```kconfig
# Target: ESP32-C5
CONFIG_IDF_TARGET="esp32c5"

# Flash: 4MB (ESP32-C5-KITC-A V1.2 has 4MB flash)
CONFIG_ESPTOOLPY_FLASHSIZE_4MB=y
CONFIG_ESPTOOLPY_FLASHSIZE="4MB"

# Custom partition table (has zb_storage and zb_fct required by Zigbee stack)
CONFIG_PARTITION_TABLE_CUSTOM=y
CONFIG_PARTITION_TABLE_CUSTOM_FILENAME="partitions.csv"
CONFIG_PARTITION_TABLE_OFFSET=0x8000

# Zigbee stack
CONFIG_ZB_ENABLED=y
CONFIG_ZB_RADIO_NATIVE=y
CONFIG_ZB_ZCZR=y

# ESP-IDF 5.5.x + esp-zigbee-lib 1.6.x no longer expose the old Zigbee
# Kconfig symbols for coordinator role, security/NVRAM toggles, network size
# or main scheduler stack. Those are handled by the stack defaults and by
# runtime configuration in main/zigbee_core.c.

# Console / UART
CONFIG_ESP_CONSOLE_UART_DEFAULT=y
CONFIG_ESP_CONSOLE_SECONDARY_NONE=y
CONFIG_ESP_CONSOLE_UART_NUM=0
CONFIG_ESP_CONSOLE_UART_BAUDRATE=115200

# Logging
CONFIG_LOG_DEFAULT_LEVEL_INFO=y
CONFIG_LOG_MAXIMUM_LEVEL_DEBUG=y

# FreeRTOS
CONFIG_FREERTOS_HZ=1000
CONFIG_FREERTOS_TASK_NOTIFICATION_ARRAY_ENTRIES=1

# Watchdog: increase timeout for Zigbee operations
CONFIG_ESP_TASK_WDT_TIMEOUT_S=30

# Heap: enable internal heap tracking
CONFIG_HEAP_TRACING_OFF=y

# NVS: ensure enough space
CONFIG_NVS_ASSERT_ERROR_CHECK=n

# LEDC (PWM for LED) is available by default

# RMT: used by led_strip for WS2812
CONFIG_RMT_ISR_IRAM_SAFE=y

# Disable BT to save RAM
CONFIG_BT_ENABLED=n

# Disable WiFi to save RAM
CONFIG_ESP_WIFI_ENABLED=n

# Ethernet: W5500 SPI driver
CONFIG_ETH_USE_SPI_ETHERNET=y
CONFIG_ETH_SPI_ETHERNET_W5500=y
```

## sdkconfig.defaults.esp32c5
```kconfig
# Target: ESP32-C5-KITC-A V1.2
CONFIG_IDF_TARGET="esp32c5"

# Flash: 4MB
CONFIG_ESPTOOLPY_FLASHSIZE_4MB=y
CONFIG_ESPTOOLPY_FLASHSIZE="4MB"

# Console / UART
CONFIG_ESP_CONSOLE_UART_DEFAULT=y
CONFIG_ESP_CONSOLE_SECONDARY_NONE=y
CONFIG_ESP_CONSOLE_UART_NUM=0
CONFIG_ESP_CONSOLE_UART_BAUDRATE=115200
```

## sdkconfig.defaults.esp32c6
```kconfig
# Target: ESP32-C6 Super Mini
CONFIG_IDF_TARGET="esp32c6"

# Flash: 4MB
CONFIG_ESPTOOLPY_FLASHSIZE_4MB=y
CONFIG_ESPTOOLPY_FLASHSIZE="4MB"

# Console / native USB-C on ESP32-C6 Super Mini
# CONFIG_ESP_CONSOLE_UART_DEFAULT is not set
CONFIG_ESP_CONSOLE_USB_SERIAL_JTAG=y
CONFIG_ESP_CONSOLE_SECONDARY_NONE=y
```
